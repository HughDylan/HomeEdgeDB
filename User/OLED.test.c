#include "OLED.h"
#include "Delay.h"

#define OLED_SCL  GPIO_Pin_8
#define OLED_SDA  GPIO_Pin_9
#define OLED_GPIO GPIOB

/* 微秒级延时 (72MHz 下这个循环大约 1~2 微秒) */
static void I2C_Delay(void) {
    volatile uint8_t i = 30;
    while (i--);
}

/* ---------------- 引脚初始化：开漏输出 ---------------- */
void OLED_GPIO_Init(void) {
    RCC_APB2PeriphClockCmd(RCC_APB2Periph_GPIOB, ENABLE);
    GPIO_InitTypeDef GPIO_InitStructure;
    
    GPIO_InitStructure.GPIO_Pin = OLED_SCL | OLED_SDA;
    GPIO_InitStructure.GPIO_Mode = GPIO_Mode_Out_OD; // 开漏输出，既能主动拉低，也能外部上拉拉高
    GPIO_InitStructure.GPIO_Speed = GPIO_Speed_50MHz;
    GPIO_Init(OLED_GPIO, &GPIO_InitStructure);
    
    /* 空闲状态两根线都是高 */
    GPIO_SetBits(OLED_GPIO, OLED_SCL | OLED_SDA);
    Delay_ms(100); /* 等屏上电稳定 */
}

/* ---------------- I2C 起始 ---------------- */
static void I2C_Start(void) {
    GPIO_SetBits(OLED_GPIO, OLED_SDA);
    GPIO_SetBits(OLED_GPIO, OLED_SCL);
    I2C_Delay();
    GPIO_ResetBits(OLED_GPIO, OLED_SDA);
    I2C_Delay();
    GPIO_ResetBits(OLED_GPIO, OLED_SCL);
}

/* ---------------- I2C 停止 ---------------- */
static void I2C_Stop(void) {
    GPIO_ResetBits(OLED_GPIO, OLED_SDA);
    GPIO_SetBits(OLED_GPIO, OLED_SCL);
    I2C_Delay();
    GPIO_SetBits(OLED_GPIO, OLED_SDA);
    I2C_Delay();
}

/* ---------------- 发一个字节，返回应答 ---------------- */
static uint8_t I2C_SendByte(uint8_t byte) {
    uint8_t i, ack;
    for (i = 0; i < 8; i++) {
        if (byte & 0x80) GPIO_SetBits(OLED_GPIO, OLED_SDA);
        else             GPIO_ResetBits(OLED_GPIO, OLED_SDA);
        byte <<= 1;
        I2C_Delay();
        GPIO_SetBits(OLED_GPIO, OLED_SCL);
        I2C_Delay();
        GPIO_ResetBits(OLED_GPIO, OLED_SCL);
    }
    /* 第 9 拍：释放 SDA，读从机应答 */
    GPIO_SetBits(OLED_GPIO, OLED_SDA);
    I2C_Delay();
    GPIO_SetBits(OLED_GPIO, OLED_SCL);
    I2C_Delay();
    ack = GPIO_ReadInputDataBit(OLED_GPIO, OLED_SDA); // 0 表示有应答
    GPIO_ResetBits(OLED_GPIO, OLED_SCL);
    return ack;
}

/* ---------------- 探测某个地址有没有设备应答 ---------------- */
uint8_t OLED_Probe(uint8_t addr7) {
    uint8_t ack;
    I2C_Start();
    ack = I2C_SendByte(addr7 << 1); /* 7位地址左移一位 + 写标志 */
    I2C_Stop();
    return ack;
}

/* ---------------- 写命令 / 写数据 ---------------- */
void OLED_WriteCmd(uint8_t cmd) {
    I2C_Start();
    I2C_SendByte(0x78); // 默认 0x78 (即7位地址0x3C << 1)
    I2C_SendByte(0x00); // 0x00 = 接下来是命令
    I2C_SendByte(cmd);
    I2C_Stop();
}

void OLED_WriteData(uint8_t dat) {
    I2C_Start();
    I2C_SendByte(0x78);
    I2C_SendByte(0x40); // 0x40 = 接下来是数据
    I2C_SendByte(dat);
    I2C_Stop();
}

/* ---------------- 初始化序列（含救命电荷泵） ---------------- */
void OLED_Init(void) {
    OLED_WriteCmd(0xAE); /* 关显示 */
    OLED_WriteCmd(0xD5); /* 时钟分频 */
    OLED_WriteCmd(0x80);
    OLED_WriteCmd(0xA8); /* 复用率 */
    OLED_WriteCmd(0x3F);
    OLED_WriteCmd(0xD3); /* 显示偏移 */
    OLED_WriteCmd(0x00);
    OLED_WriteCmd(0x40); /* 起始行 */
    OLED_WriteCmd(0x8D); /* 👈 电荷泵设置 */
    OLED_WriteCmd(0x14); /* 👈 👈 核心！开启电荷泵，少了这行很多屏永远黑 */
    OLED_WriteCmd(0x20); /* 水平寻址 */
    OLED_WriteCmd(0x00);
    OLED_WriteCmd(0xA1); /* 左右方向 */
    OLED_WriteCmd(0xC8); /* 上下方向 */
    OLED_WriteCmd(0xDA); /* COM 引脚配置 */
    OLED_WriteCmd(0x12);
    OLED_WriteCmd(0x81); /* 对比度 */
    OLED_WriteCmd(0xCF);
    OLED_WriteCmd(0xD9); /* 预充电周期 */
    OLED_WriteCmd(0xF1);
    OLED_WriteCmd(0xDB); /* VCOMH */
    OLED_WriteCmd(0x40);
    OLED_WriteCmd(0xA4); /* 正常显示 */
    OLED_WriteCmd(0xA6); /* 正常显示(不反色) */
    OLED_WriteCmd(0xAF); /* 开显示 */
}
/* ---------------- 全屏填充测试 ---------------- */
void OLED_FillTest(void) {
    uint8_t page, i;
    
    /* ① 全亮测试 */
    OLED_WriteCmd(0xA4); // 回到"跟随显存"模式，关掉强制全亮
    for (page = 0; page < 8; page++) {
        OLED_WriteCmd(0xB0 + page); // 选第几页 (0-7)
        OLED_WriteCmd(0x00);        // 列地址低 4 位
        OLED_WriteCmd(0x10);        // 列地址高 4 位
        for (i = 0; i < 128; i++) {
            OLED_WriteData(0xFF);   // 8个像素全亮
        }
    }
    Delay_ms(600);
    
    /* ② 全灭测试 */
    for (page = 0; page < 8; page++) {
        OLED_WriteCmd(0xB0 + page);
        OLED_WriteCmd(0x00);
        OLED_WriteCmd(0x10);
        for (i = 0; i < 128; i++) {
            OLED_WriteData(0x00);   // 8个像素全灭
        }
    }
    Delay_ms(600);
}
/* ================== 简单字库 (8x16 ASCII) ================== */
const unsigned char F6x8[][6] = {
    {0x00,0x00,0x00,0x00,0x00,0x00}, // sp
    {0x00,0x00,0x00,0x2f,0x00,0x00}, // !
    {0x00,0x00,0x07,0x00,0x07,0x00}, // "
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    {0x00,0x61,0x51,0x49,0x45,0x43}, // Z
};

/* 设置光标位置 (x: 0-127, y: 0-7行) */
void OLED_SetCursor(uint8_t x, uint8_t y) {
    OLED_WriteCmd(0xB0 + y);
    OLED_WriteCmd(((x & 0xF0) >> 4) | 0x10);
    OLED_WriteCmd(x & 0x0F);
}

/* 显示字符串 */
void OLED_ShowString(uint8_t Line, uint8_t Column, char *String) {
    uint8_t i;
    uint8_t x = (Column - 1) * 6;  // 每列 6 个像素宽
    uint8_t y = Line - 1;          // 页地址 (0-7)
    
    OLED_SetCursor(x, y);
    for (i = 0; String[i] != '\0'; i++) {
        // 简单处理：只支持大写字母和数字，如果是小写字母，转成大写
        char c = String[i];
        if (c >= 'a' && c <= 'z') c -= 32; 
        
        // 减去 32 是因为字库从空格 (ASCII 32) 开始
        if (c >= 32 && c <= 90) {
            for (uint8_t j = 0; j < 6; j++) {
                OLED_WriteData(F6x8[c - 32][j]);
            }
        }
    }
}
